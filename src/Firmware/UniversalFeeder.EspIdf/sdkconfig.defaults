## src/Firmware/UniversalFeeder.EspIdf/sdkconfig.defaults
```kconfig
# ESP-IDF Configuration Defaults for UniversalFeeder

# Enable Bluetooth with NimBLE stack
CONFIG_BT_ENABLED=y
CONFIG_BT_NIMBLE_ENABLED=y
CONFIG_BT_BLE_ENABLED=y

# WiFi Configuration
CONFIG_ESP_WIFI_STATIC_RX_BUFFER_NUM=10
CONFIG_ESP_WIFI_DYNAMIC_RX_BUFFER_NUM=32
CONFIG_ESP_WIFI_DYNAMIC_TX_BUFFER_NUM=32

# Flash configuration
CONFIG_ESPTOOLPY_FLASHSIZE_4MB=y
CONFIG_ESPTOOLPY_FLASHSIZE="4MB"

# MQTT over TCP
CONFIG_MQTT_PROTOCOL_311=y

# Logging
CONFIG_LOG_DEFAULT_LEVEL_INFO=y

# FreeRTOS
CONFIG_FREERTOS_HZ=1000
```
